// SPDX-License-Identifier: GPL-2.0+
/* mid7021 CAMERA-ONLY overlay (no touch/audio - protects working subsystems) */
#include <dt-bindings/interrupt-controller/arm-gic.h>
#include <dt-bindings/interrupt-controller/irq.h>
#include <dt-bindings/pinctrl/mt6765-pinfunc.h>
#include <dt-bindings/clock/mt6765-clk.h>
/dts-v1/;
/plugin/;
#include "mediatek/cust_mt6765_camera_mid7021.dtsi"
